## experiments/vlm_split/espdet_probe/sdkconfig.defaults
```kconfig
CONFIG_IDF_TARGET="esp32s3"
CONFIG_ESPTOOLPY_FLASHMODE_DIO=y
CONFIG_ESPTOOLPY_FLASHSIZE_4MB=y
CONFIG_PARTITION_TABLE_CUSTOM=y
CONFIG_PARTITION_TABLE_CUSTOM_FILENAME="../../../partitions_mobility_ota.csv"
CONFIG_PARTITION_TABLE_OFFSET=0x8000
CONFIG_BOOTLOADER_APP_ROLLBACK_ENABLE=y
CONFIG_COMPILER_OPTIMIZATION_PERF=y
CONFIG_SPIRAM=y
CONFIG_SPIRAM_MODE_OCT=y
CONFIG_SPIRAM_SPEED_40M=y
CONFIG_SPIRAM_USE_MALLOC=y
CONFIG_SPIRAM_MALLOC_ALWAYSINTERNAL=1024
CONFIG_SPIRAM_MALLOC_RESERVE_INTERNAL=32768
CONFIG_ESP_DEFAULT_CPU_FREQ_MHZ_240=y
CONFIG_ESP32S3_INSTRUCTION_CACHE_32KB=y
CONFIG_ESP32S3_DATA_CACHE_64KB=y
CONFIG_ESP32S3_DATA_CACHE_LINE_64B=y
CONFIG_ESP_CONSOLE_USB_SERIAL_JTAG=y
CONFIG_ESP_CONSOLE_SECONDARY_NONE=y
CONFIG_ESP_MAIN_TASK_STACK_SIZE=16384
CONFIG_FREERTOS_HZ=1000
CONFIG_ESP_TASK_WDT_TIMEOUT_S=5
CONFIG_FLASH_ESPDET_PICO_224_224_CAT=y
CONFIG_FLASH_ESPDET_PICO_416_416_CAT=n
CONFIG_CAT_DETECT_MODEL_IN_FLASH_RODATA=y

# CONFIG_PIX_CVT_RGB565_TO_RGB565_SUPPORT is not set

# CONFIG_PIX_CVT_RGB565_TO_RGB888_SUPPORT is not set

# CONFIG_PIX_CVT_RGB565_TO_GRAY_SUPPORT is not set

# CONFIG_PIX_CVT_RGB565_TO_HSV_SUPPORT is not set

# CONFIG_PIX_CVT_RGB888_TO_RGB565_SUPPORT is not set

# CONFIG_PIX_CVT_RGB888_TO_GRAY_SUPPORT is not set

# CONFIG_PIX_CVT_RGB888_TO_HSV_SUPPORT is not set

# CONFIG_PIX_CVT_GRAY_TO_GRAY_SUPPORT is not set

# CONFIG_PIX_CVT_HSV_TO_HSV_MASK_SUPPORT is not set

# CONFIG_PIX_CVT_YUV_TO_RGB888_SUPPORT is not set

# CONFIG_PIX_CVT_YUV_TO_RGB565_SUPPORT is not set

# CONFIG_PIX_CVT_YUV_TO_GRAY_SUPPORT is not set

# CONFIG_PIX_CVT_YUV_TO_HSV_SUPPORT is not set

# CONFIG_PIX_CVT_YUV_TO_YUV_SUPPORT is not set
```
